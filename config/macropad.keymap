#include <behaviors.dtsi>
#include <dt-bindings/zmk/bt.h>
#include <dt-bindings/zmk/keys.h>

/ {
    keymap {
        compatible = "zmk,keymap";

        default_layer {
            bindings = <
&kp KP_N7  &mo 1  &kp KP_N9  
            >;
        };

        bt_layer {
            bindings = <
&none         &none         &kp B    
            >;
        };
    };
};
